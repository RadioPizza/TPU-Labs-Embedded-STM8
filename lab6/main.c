#include "main.h"

#define IS_TIMER_OVERFLOW() (TIM1_SR1 & (1 << 0))

// Глобальные переменные для управления ШИМ
volatile uint16_t ccr1_value = 100;     // Начальное значение CCR1 (1 мс)
volatile int8_t direction = 1;          // Направление изменения: +1 - увеличение, -1 - уменьшение

/**
 * @brief Обработчик прерывания таймера TIM1 (переполнение).
 */
@far @interrupt void TIM1_IRQHandler(void)
{
    if (TIM1_SR1 & (1 << 0))  // Проверка флага UIF (переполнение)
    {
        TIM1_SR1 &= ~(1 << 0);  // Сброс флага

        // Изменение значения CCR1
        ccr1_value += direction;

        // Проверка границ (1 мс ≤ импульс ≤ 2 мс)
        if (ccr1_value >= 200)  // 200 * 10 мкс = 2 мс
        {
            direction = -1;  // Меняем направление на уменьшение
        }
        else if (ccr1_value <= 100)  // 100 * 10 мкс = 1 мс
        {
            direction = 1;   // Меняем направление на увеличение
        }

        // Обновление регистра CCR1
        TIM1_CCR1H = (ccr1_value >> 8) & 0xFF;  // Старший байт
        TIM1_CCR1L = ccr1_value & 0xFF;         // Младший байт
    }
}

/**
 * @brief Инициализация аппаратного ШИМ на канале 1 таймера TIM1.
 */
void tim1_init_pwm(void)
{
    // Настройки из пункта 13:
    TIM1_CCMR1 = 0x68;  // PWM1, предварительная загрузка CCR1
    TIM1_CCER1 = 0x01;  // Включение канала 1
    TIM1_BKR = 0x80;    // Разрешение выхода (MOE=1)
    
    // Делитель для частоты 100 кГц (2 МГц / 20 = 100 кГц)
    TIM1_PSCRH = 0x00;  // PSCR = 19 (0x0013)
    TIM1_PSCRL = 0x13;
    
    // Период ШИМ = 20 мс (ARR = 1999)
    TIM1_ARRH = 0x07;   // ARR = 1999 (0x07CF)
    TIM1_ARRL = 0xCF;
    
    // Начальная длительность импульса = 1 мс (CCR1 = 100)
    TIM1_CCR1H = 0x00;
    TIM1_CCR1L = 0x64;

    // Разрешение прерывания по переполнению
    TIM1_IER |= (1 << 0);  // UIE=1
}

void main(void)
{
    // Настройка вывода PC1 (TIM1_CH1)
    PC_DDR |= (1 << 1); // Направление: выход
    PC_CR1 |= (1 << 1); // Режим: push-pull
    PC_CR2 |= (1 << 1); // Скорость: 10 МГц

    // Инициализация ШИМ
    tim1_init_pwm();

    // Запуск таймера
    TIM1_CR1 |= (1 << 0); // Включение таймера (CEN=1)

    _asm("rim");           // Разрешить глобальные прерывания
}